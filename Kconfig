## Kconfig
```kconfig
#
# For a description of the syntax of this configuration file,
# see the file kconfig-language.txt in the NuttX tools repository.
#

choice
	prompt "Select build type"
	default BUILD_TYPE_NUTTX
	---help---
		Select the build type.

config BUILD_TYPE_NUTTX
	bool "Nuttx Type"
	---help---
		Nuttx OS based build.

endchoice
```

## configs/Kconfig
```kconfig
#
# For a description of the syntax of this configuration file,
# see the file kconfig-language.txt in the NuttX tools repository.
#

choice
	prompt "Select target board"
	---help---
		Select the board hosting the architecture.  You must first select the
		exact MCU part number, then the boards supporting that part will
		be available for selection.  Use ARCH_BOARD_CUSTOM to create a new
		board configuration.

config ARCH_BOARD_ABIES
	bool "Pinecone Abies"
	---help---
		Pinecone Abies SoC.

config ARCH_BOARD_BANKS
	bool "Pinecone Banks"
	---help---
		Pinecone Banks SoC.

config ARCH_BOARD_U1
	bool "Pinecone U1"
	---help---
		Pinecone U1 MCU.

config ARCH_BOARD_U11
	bool "Pinecone U11"
	---help---
		Pinecone U11 MCU.

config ARCH_BOARD_U2
	bool "Pinecone U2"
	---help---
		Pinecone U2 MCU.

config ARCH_BOARD_U3
	bool "Pinecone U3"
	---help---
		Pinecone U3 MCU.

config ARCH_BOARD_V1
	bool "Pinecone V1"
	---help---
		Pinecone V1 SoC.

endchoice

if ARCH_BOARD_U1
source "configs/song/u1/Kconfig"
endif
```

## configs/u1/Kconfig
```kconfig
#
# For a description of the syntax of this configuration file,
# see the file kconfig-language.txt in the NuttX tools repository.
#

choice
	prompt "Select target application"

config U1_AP
	bool "U1 AP"

config U1_APLITE
	bool "U1 APLITE"

config U1_APU1X
	bool "U1 APU1X"

config U1_CK
	bool "U1 CK"

config U1_CP
	bool "U1 CP"

config U1_CPU1X
	bool "U1 CPU1X"

config U1_SP
	bool "U1 SP"

config U1_SPU1X
	bool "U1 SPU1X"

config U1_FVP
	bool "U1 FVP"

config U1_RECOVERY
	bool "U1 recovery"

config U1_SIM
	bool "U1 SIM"

config U1_APFACTORY
	bool "U1 APFACTORY"

config U1_APFISHNB
	bool "U1 APFISHNB"

endchoice
```

## configs/u2/Kconfig
```kconfig
#
# For a description of the syntax of this configuration file,
# see the file kconfig-language.txt in the NuttX tools repository.
#

choice
	prompt "Select target application"

config U2_AP
	bool "U2 AP"

config U2_APV3
	bool "U2 APV3"

config U2_AUDIO
	bool "U2 Audio"

config U2_CK
	bool "U2 CK"

config U2_M4
	bool "U2 M4"

endchoice
```
